## boards/shields/vireal_dactyl/Kconfig.defconfig
```kconfig
if SHIELD_VIREAL_DACTYL_RIGHT
config ZMK_KEYBOARD_NAME
    default "mini-dactyl"
# Enable display on the central side (right)
config ZMK_DISPLAY
    default y
endif

if SHIELD_VIREAL_DACTYL_LEFT
config ZMK_KEYBOARD_NAME
    default "mini-dactyl-l"
config ZMK_SPLIT_ROLE_CENTRAL
    default y
# Display on the left side too
config ZMK_DISPLAY
    default y
endif

if SHIELD_VIREAL_DACTYL_RIGHT || SHIELD_VIREAL_DACTYL_LEFT
config ZMK_SPLIT
    default y
config ZMK_STUDIO
    default y
endif

if ZMK_DISPLAY
    config I2C
        default y
    config SSD1306
        default y
    config ZMK_DISPLAY_BLANK_ON_IDLE
        default y
        
    # LVGL configurations - using only validated options
    config LV_Z_VDB_SIZE
        default 64
    config LV_Z_BITS_PER_PIXEL
        default 1
    config ZMK_DISPLAY_INVERT
        default y
endif # ZMK_DISPLAY
```

## boards/shields/vireal_dactyl/Kconfig.shield
```kconfig
config SHIELD_VIREAL_DACTYL_LEFT
    def_bool $(shields_list_contains,vireal_dactyl_left)

config SHIELD_VIREAL_DACTYL_RIGHT
    def_bool $(shields_list_contains,vireal_dactyl_right)
```
